# file: FLASH_EDATA_EraseProgram.ioc
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CORTEX_M33_NS.userName=CORTEX_M33
Mcu.Family=STM32H5
Mcu.Name=STM32H533RETx
Mcu.Package=LQFP64
NVIC.PriorityGroup=NVIC_PRIORITYGROUP_4
PH0-OSC_IN(PH0).Mode=HSE-External-Oscillator
PH0-OSC_IN(PH0).Signal=RCC_OSC_IN
PH1-OSC_OUT(PH1).Mode=HSE-External-Oscillator
PH1-OSC_OUT(PH1).Signal=RCC_OSC_OUT
ProjectManager.HeapSize=0x200
ProjectManager.StackSize=0x400
ProjectManager.TargetToolchain=EWARM V9.20
RCC.ADCFreq_Value=250000000
RCC.AHBFreq_Value=250000000
RCC.APB1Freq_Value=250000000
RCC.APB1TimFreq_Value=250000000
RCC.APB2Freq_Value=250000000
RCC.APB2TimFreq_Value=250000000
RCC.APB3Freq_Value=250000000
RCC.CSI_VALUE=4000000
RCC.CortexFreq_Value=250000000
RCC.EPOD_VALUE=24000000
RCC.HCLKFreq_Value=250000000
RCC.HSE_VALUE=24000000
RCC.HSI48_VALUE=48000000
RCC.HSI_VALUE=64000000
RCC.LSE_VALUE=32768
RCC.LSIRC_VALUE=32000
RCC.PLLM=12
RCC.PLLN=250
RCC.PLLSourceVirtual=RCC_PLL1_SOURCE_HSE
RCC.SYSCLKFreq_VALUE=250000000
RCC.SYSCLKSource=RCC_SYSCLKSOURCE_PLLCLK
RCC.USBFreq_Value=48000000
RCC.VCOOutputFreq_Value=500000000
VP_ICACHE_VS_ICACHE.Mode=DefaultMode
VP_PWR_VS_DBSignals.Mode=DisableDeadBatterySignals
VP_PWR_VS_LPOM.Mode=PowerOptimisation
VP_PWR_VS_SECSignals.Mode=Security/Privilege
board=custom

// file: Src/main.c
/* USER CODE BEGIN Header */
/**
  ******************************************************************************
  * @file    FLASH/FLASH_EDATA_EraseProgram/Src/main.c
  * @author  MCD Application Team
  * @brief   This example provides a description of how to erase and program the
  *          STM32H5xx high-cycle FLASH area.
  ******************************************************************************
  * @attention
  *
  * Copyright (c) 2023 STMicroelectronics.
  * All rights reserved.
  *
  * This software is licensed under terms that can be found in the LICENSE file
  * in the root directory of this software component.
  * If no LICENSE file comes with this software, it is provided AS-IS.
  *
  ******************************************************************************
  */
/* USER CODE END Header */
#include "main.h"

/* USER CODE BEGIN PD */

/* Start @ of user Flash eData area */
#define EDATA_USER_START_ADDR   ADDR_EDATA1_STRT_7
/* End @ of user Flash eData area */
/* (FLASH_EDATA_SIZE/16) is the sector size of high-cycle area (6KB) */
#define EDATA_USER_END_ADDR     (ADDR_EDATA1_STRT_7 + (8*(FLASH_EDATA_SIZE/16)) - 1)

/* USER CODE END PD */

/* USER CODE BEGIN PV */
uint32_t FirstSector = 0, NbOfSectors = 0, EndSector = 0;
uint32_t Address = 0, SectorError = 0;
uint32_t Index= 0;

uint32_t offset = 2;
uint16_t FlashHalfWord[1] = { 0xAA55 };
uint16_t FlashHalfWord_FF[1] = { 0xFFFF };

/*Variable used for Erase procedure*/
static FLASH_EraseInitTypeDef EraseInitStruct;
/* Variable used for OB Program procedure */
FLASH_OBProgramInitTypeDef FLASH_OBInitStruct;

/* USER CODE END PV */

void SystemClock_Config(void);
static void MX_GPIO_Init(void);
static void MX_ICACHE_Init(void);
/* USER CODE BEGIN PFP */
static uint32_t GetSector_EDATA(uint32_t Address);
static uint32_t GetBank_EDATA(uint32_t Address);
static void MPU_Config(void);
static uint32_t Check_Flash_Content(uint32_t StartAddress, uint32_t EndAddress, uint16_t *Data);

/* USER CODE END PFP */

int main(void)
{

  /* USER CODE BEGIN 1 */

  /* STM32H5xx HAL library initialization:
       - Systick timer is configured by default as source of time base, but user
             can eventually implement his proper time base source (a general purpose
             timer for example or other time source), keeping in mind that Time base
             duration should be kept 1ms since PPP_TIMEOUT_VALUEs are defined and
             handled in milliseconds basis.
       - Set NVIC Group Priority to 4
       - Low Level Initialization
     */

  /* USER CODE END 1 */

  /* MCU Configuration--------------------------------------------------------*/

  /* Reset of all peripherals, Initializes the Flash interface and the Systick. */
  HAL_Init();

  /* USER CODE BEGIN Init */
  /* Configure the system clock to 250 MHz */
  /* USER CODE END Init */

  /* Configure the system clock */
  SystemClock_Config();

  /* Initialize all configured peripherals */
  MX_GPIO_Init();
  MX_ICACHE_Init();
  /* USER CODE BEGIN 2 */
  /* MPU Configuration--------------------------------------------------------*/
  /* By default, all the AHB memory range is cacheable. For regions where caching is not
     practical (High-cycle data area), MPU has to be used to disable local cacheability.
  */
  MPU_Config();
  /* Initialize LED2 */
  BSP_LED_Init(LED2);

  /* Unlock the Flash to enable the flash control register access *************/
  HAL_FLASH_Unlock();

  /* Unlock the Flash option bytes to enable the flash option control register access */
  HAL_FLASH_OB_Unlock();

  /* Erase the EDATA Flash area
    (area defined by EDATA_USER_START_ADDR and EDATA_USER_END_ADDR) ***********/

  /* Get the 1st sector of FLASH high-cycle data area */
  FirstSector = GetSector_EDATA(EDATA_USER_START_ADDR);

  /* Get the last sector of FLASH high-cycle data area */
  EndSector = GetSector_EDATA(EDATA_USER_END_ADDR);

  /* Get the number of sectors */
  NbOfSectors = EndSector - FirstSector + 1;

  /* Configure 8 sectors for FLASH high-cycle data */
  FLASH_OBInitStruct.OptionType = OPTIONBYTE_EDATA;
  FLASH_OBInitStruct.Banks = GetBank_EDATA(EDATA_USER_START_ADDR);
  FLASH_OBInitStruct.EDATASize = NbOfSectors;
  if(HAL_FLASHEx_OBProgram(&FLASH_OBInitStruct) != HAL_OK)
  {
    Error_Handler();
  }

  /* Start option byte load operation after successful programming operation */
  HAL_FLASH_OB_Launch();

  /* Get the first sector of FLASH high-cycle data area */
  FirstSector = GetSector_EDATA(EDATA_USER_START_ADDR);

  /* Get the last sector of FLASH high-cycle data area */
  EndSector = GetSector_EDATA(EDATA_USER_END_ADDR);

  /* Get the number of sectors to erase */
  NbOfSectors = EndSector - FirstSector + 1;

  EraseInitStruct.TypeErase = FLASH_TYPEERASE_SECTORS;
  EraseInitStruct.Banks = GetBank_EDATA(EDATA_USER_START_ADDR);
  EraseInitStruct.Sector = FirstSector;
  EraseInitStruct.NbSectors = NbOfSectors;

  if (HAL_FLASHEx_Erase(&EraseInitStruct, &SectorError) != HAL_OK)
  {
    /*
      Error occurred while sector erase.
      User can add here some code to deal with this error.
      SectorError will contain the faulty sector and then to know the code error on this sector,
      user can call function 'HAL_FLASH_GetError()'
    */
    /* Infinite loop */
    Error_Handler();
  }

  /* Program the FLASH high-cycle data area of BANK1 */
  Address = EDATA_USER_START_ADDR;

  while(Address < EDATA_USER_END_ADDR)
  {
    if (HAL_FLASH_Program(FLASH_TYPEPROGRAM_HALFWORD_EDATA, Address, (uint32_t)FlashHalfWord) == HAL_OK)
    {
      Address = Address + offset; /* increment for the next Flash word*/
    }
    else
    {
      /* Error occurred while half word Programming */
      Error_Handler();
    }
  }

  /* Check if the programmed data is OK */
  if (Check_Flash_Content(EDATA_USER_START_ADDR, EDATA_USER_END_ADDR, FlashHalfWord) != 0)
  {
    Error_Handler();
  }

  /* Disable the FLASH High-cycle data */
  FLASH_OBInitStruct.OptionType = OPTIONBYTE_EDATA;
  FLASH_OBInitStruct.Banks = GetBank_EDATA(EDATA_USER_START_ADDR);
  FLASH_OBInitStruct.EDATASize = 0;
  if (HAL_FLASHEx_OBProgram(&FLASH_OBInitStruct) != HAL_OK)
  {
    Error_Handler();
  }

  /* Start option byte load operation after successful programming operation */
  HAL_FLASH_OB_Launch();

  /* Lock the Flash to disable the flash control register access (recommended
     to protect the FLASH memory against possible unwanted operation)
  */
  HAL_FLASH_Lock();

  /* Lock the Flash control option to restrict register access */
  HAL_FLASH_OB_Lock();

  /* No error detected. Switch on LED2*/
  BSP_LED_On(LED2);

  /* USER CODE END 2 */

  /* Infinite loop */
  while (1)
  {

  }
}

void SystemClock_Config(void)
{
  RCC_OscInitTypeDef RCC_OscInitStruct = {0};
  RCC_ClkInitTypeDef RCC_ClkInitStruct = {0};

  /** Configure the main internal regulator output voltage
  */
  __HAL_PWR_VOLTAGESCALING_CONFIG(PWR_REGULATOR_VOLTAGE_SCALE0);

  while(!__HAL_PWR_GET_FLAG(PWR_FLAG_VOSRDY)) {}

  /** Initializes the RCC Oscillators according to the specified parameters
  * in the RCC_OscInitTypeDef structure.
  */
  RCC_OscInitStruct.OscillatorType = RCC_OSCILLATORTYPE_HSE;
  RCC_OscInitStruct.HSEState = RCC_HSE_ON;
  RCC_OscInitStruct.PLL.PLLState = RCC_PLL_ON;
  RCC_OscInitStruct.PLL.PLLSource = RCC_PLL1_SOURCE_HSE;
  RCC_OscInitStruct.PLL.PLLM = 12;
  RCC_OscInitStruct.PLL.PLLN = 250;
  RCC_OscInitStruct.PLL.PLLP = 2;
  RCC_OscInitStruct.PLL.PLLQ = 2;
  RCC_OscInitStruct.PLL.PLLR = 2;
  RCC_OscInitStruct.PLL.PLLRGE = RCC_PLL1_VCIRANGE_1;
  RCC_OscInitStruct.PLL.PLLVCOSEL = RCC_PLL1_VCORANGE_WIDE;
  RCC_OscInitStruct.PLL.PLLFRACN = 0;
  if (HAL_RCC_OscConfig(&RCC_OscInitStruct) != HAL_OK)
  {
    Error_Handler();
  }

  /** Initializes the CPU, AHB and APB buses clocks
  */
  RCC_ClkInitStruct.ClockType = RCC_CLOCKTYPE_HCLK|RCC_CLOCKTYPE_SYSCLK
                              |RCC_CLOCKTYPE_PCLK1|RCC_CLOCKTYPE_PCLK2
                              |RCC_CLOCKTYPE_PCLK3;
  RCC_ClkInitStruct.SYSCLKSource = RCC_SYSCLKSOURCE_PLLCLK;
  RCC_ClkInitStruct.AHBCLKDivider = RCC_SYSCLK_DIV1;
  RCC_ClkInitStruct.APB1CLKDivider = RCC_HCLK_DIV1;
  RCC_ClkInitStruct.APB2CLKDivider = RCC_HCLK_DIV1;
  RCC_ClkInitStruct.APB3CLKDivider = RCC_HCLK_DIV1;

  if (HAL_RCC_ClockConfig(&RCC_ClkInitStruct, FLASH_LATENCY_5) != HAL_OK)
  {
    Error_Handler();
  }

  /** Configure the programming delay
  */
  __HAL_FLASH_SET_PROGRAM_DELAY(FLASH_PROGRAMMING_DELAY_2);
}

static void MX_ICACHE_Init(void)
{

  /** Enable instruction cache (default 2-ways set associative cache)
  */
  if (HAL_ICACHE_Enable() != HAL_OK)
  {
    Error_Handler();
  }

}

static void MX_GPIO_Init(void)
{

  /* GPIO Ports Clock Enable */
  __HAL_RCC_GPIOH_CLK_ENABLE();

}

/* USER CODE BEGIN 4 */
/**
  * @brief  Gets the sector of a given address
  * @param  Addr: Address of the FLASH Memory
  * @retval The sector of a given address
  */
static uint32_t GetSector_EDATA(uint32_t Address)
{
  uint32_t sector = 0;
  uint32_t edataSectorSize = 0;

  /*
    (FLASH_EDATA_SIZE/2) is the size of high-cycle area of flash BANK1.
    Flash high-cycle area have 8 sectors in each Bank.
  */
  edataSectorSize = (FLASH_EDATA_SIZE / 2) / 8;
  /* Check if the address is located in the FLASH high-cycle data area of BANK1 */
  if((Address >= FLASH_EDATA_BASE) && (Address < FLASH_EDATA_BASE + (FLASH_EDATA_SIZE / 2)))
  {
    sector = (Address & ~FLASH_EDATA_BASE) / edataSectorSize;
    sector += 24;
  }
  /* Check if the address is located in the FLASH high-cycle data area of BANK2 */
  else if ((Address >= FLASH_EDATA_BASE + (FLASH_EDATA_SIZE / 2)) && (Address < FLASH_EDATA_BASE + FLASH_EDATA_SIZE))
  {
    sector = ((Address & ~FLASH_EDATA_BASE) - (FLASH_EDATA_SIZE / 2)) / edataSectorSize;
    sector += 24;
  }
  else
  {
    sector = 0xFFFFFFFF; /* Address out of range */
  }

  return sector;
}

/**
  * @brief  Gets the bank of a given address in EDATA area
  * @param  Addr: Address of A given address in EDATA area
  * @retval The bank of a given address in EDATA area
  */
static uint32_t GetBank_EDATA(uint32_t Addr)
{
  uint32_t bank = 0;

  /* (FLASH_EDATA_SIZE/2) is the size of high-cycle area of flash BANK1 */
  if((Addr >= FLASH_EDATA_BASE) && (Addr < FLASH_EDATA_BASE + (FLASH_EDATA_SIZE/2)))
  {
    bank = FLASH_BANK_1;
  }
  else if ((Addr >= FLASH_EDATA_BASE + (FLASH_EDATA_SIZE/2)) && (Addr < FLASH_EDATA_BASE + FLASH_EDATA_SIZE))
  {
    bank = FLASH_BANK_2;
  }
  else
  {
    bank = 0xFFFFFFFF; /* Address out of range */
  }
  return bank;
}

/**
  * @brief  Configure the MPU attributes as non-cacheable for Flash high-cycle data area
  * @note   The Base Address is Flash high-cycle data area
  * @param  None
  * @retval None
  */
static void MPU_Config(void)
{
  MPU_Attributes_InitTypeDef   attr;
  MPU_Region_InitTypeDef       region;

  /* Disable MPU before perloading and config update */
  HAL_MPU_Disable();

  /* Define cacheable memory via MPU */
  attr.Number             = MPU_ATTRIBUTES_NUMBER0;
  attr.Attributes         = 0 ;
  HAL_MPU_ConfigMemoryAttributes(&attr);

  /* BaseAddress-LimitAddress configuration */
  region.Enable           = MPU_REGION_ENABLE;
  region.Number           = MPU_REGION_NUMBER0;
  region.AttributesIndex  = MPU_ATTRIBUTES_NUMBER0;
  region.BaseAddress      = EDATA_USER_START_ADDR;
  region.LimitAddress     = EDATA_USER_END_ADDR;
  region.AccessPermission = MPU_REGION_ALL_RW;
  region.DisableExec      = MPU_INSTRUCTION_ACCESS_ENABLE;
  region.IsShareable      = MPU_ACCESS_NOT_SHAREABLE;
  HAL_MPU_ConfigRegion(&region);

  /* Enable the MPU */
  HAL_MPU_Enable(MPU_PRIVILEGED_DEFAULT);
}

/**
  * @brief  Check program operation.
  * param StartAddress Area start address
  * param EndAddress Area end address
  * param Data Expected data
  * @retval FailCounter
  */
static uint32_t Check_Flash_Content(uint32_t StartAddress, uint32_t EndAddress, uint16_t *Data)
{
  uint32_t Address;
  uint32_t FailCounter = 0;
  uint16_t data16;

  Address = StartAddress;

  while(Address < EndAddress)
  {
    for(Index = 0; Index<4; Index++)
    {
      data16 = *(uint16_t*)Address;
      if(data16 != Data[0])
      {
        FailCounter++;
      }
      Address += offset;
    }
  }
  return FailCounter;
}

/* USER CODE END 4 */

void Error_Handler(void)
{
  /* USER CODE BEGIN Error_Handler_Debug */

  while (1)
  {
      /* Make LED2 blink (100ms on, 2s off) to indicate error in Erase operation */
      BSP_LED_On(LED2);
      HAL_Delay(100);
      BSP_LED_Off(LED2);
      HAL_Delay(2000);
  }
  /* USER CODE END Error_Handler_Debug */
}
