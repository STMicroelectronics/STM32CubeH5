/* USER CODE BEGIN Header */
/**
  ******************************************************************************
  * @file    CCB/CCB_Protected_RSAModularExp_BlobUse/Src/main.c
  * @author  MCD Application Team
  * @brief   This example describes how to configure and use GPIOs through
  *          the STM32H5xx HAL API.
  ******************************************************************************
  * @attention
  *
  * Copyright (c) 2025 STMicroelectronics.
  * All rights reserved.
  *
  * This software is licensed under terms that can be found in the LICENSE file
  * in the root directory of this software component.
  * If no LICENSE file comes with this software, it is provided AS-IS.
  *
  ******************************************************************************
  */
/* USER CODE END Header */
/* Includes ------------------------------------------------------------------*/
#include "main.h"

/* Private includes ----------------------------------------------------------*/
/* USER CODE BEGIN Includes */

/* USER CODE END Includes */

/* Private typedef -----------------------------------------------------------*/
/* USER CODE BEGIN PTD */

/* USER CODE END PTD */

/* Private define ------------------------------------------------------------*/
/* USER CODE BEGIN PD */

/* USER CODE END PD */

/* Private macro -------------------------------------------------------------*/
/* USER CODE BEGIN PM */

/* USER CODE END PM */

/* Private variables ---------------------------------------------------------*/
CCB_HandleTypeDef hccb;

/* USER CODE BEGIN PV */
CCB_WrappingKeyTypeDef wrappedKeyConf;
CCB_RSAParamTypeDef RSAparam;
CCB_RSAKeyBlobTypeDef RSAKeyBlob;
CCB_RSAClearKeyTypeDef RSAKey;

/* Input buffers */
uint32_t AESIV[4]                       = {0x00010203 , 0x04050607 , 0x08090A0B , 0x0C0D0E0F};
uint32_t Wrapped_key_Buffer[8]          = {0x1ff4d7fb, 0xbb515f14, 0x676df6b4, 0xcb58c0c8, 0x2b48e65e, 0xf9bfcf32, 0xd9c0a66c, 0xeec362d7};

uint8_t RSA4096_exp_P[512]              = { 0x28, 0x28, 0x5d, 0x3a, 0x7e, 0x14, 0x8f, 0x2f, 0x63, 0x4b, 0x90, 0x97, 0x37, 0xa2, 0xf0,
                                            0x6a, 0xba, 0xa5, 0x7e, 0xe8, 0x6a, 0xe5, 0xf3, 0x4d, 0x52, 0xe2, 0xfb, 0xbe, 0xf3, 0x27,
                                            0xab, 0xdb, 0x5a, 0x45, 0xf2, 0xa0, 0xa6, 0x70, 0x12, 0x2d, 0x5d, 0xc0, 0x42, 0x5d, 0xee,
                                            0xf8, 0xc1, 0xd7, 0x10, 0x46, 0xef, 0xd5, 0x03, 0x47, 0xed, 0xcd, 0x71, 0x19, 0xf1, 0x39,
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                                            0x5a, 0x8f};
uint8_t RSA4096_expBase[512]            = { 0x4b, 0x26, 0xe6, 0xd6, 0x27, 0x3c, 0xb6, 0x5e, 0x5c, 0xff, 0x06, 0x97, 0x02, 0x67, 0x5b,
                                            0x71, 0x13, 0x5d, 0x3d, 0x0a, 0xb5, 0x4d, 0x4b, 0xbc, 0xbf, 0xf2, 0x91, 0x69, 0x7e, 0xb5,
                                            0xd8, 0x9f, 0x19, 0xed, 0xda, 0x9e, 0x30, 0x92, 0x33, 0x46, 0x70, 0xef, 0xe5, 0xb6, 0x02,
                                            0x15, 0x6c, 0x68, 0x31, 0x3b, 0x81, 0xe2, 0xfb, 0xc2, 0xc7, 0x56, 0x1d, 0x98, 0x14, 0xfa,
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                                            0x6b, 0x08};

uint8_t RSA4096_phi_P[512]              = { 0xd1, 0xea, 0x52, 0xbb, 0xdb, 0xd6, 0xe7, 0x09, 0x79, 0x51, 0x26, 0xe7, 0x49, 0xa9, 0xef,
                                            0xa3, 0x47, 0x9f, 0x92, 0xd6, 0xf1, 0xb4, 0x45, 0x5e, 0x39, 0xe4, 0xb6, 0x8a, 0xcd, 0xf9,
                                            0xff, 0x43, 0xf2, 0x2e, 0xc1, 0xc4, 0x02, 0xd5, 0x1f, 0x7c, 0x03, 0x03, 0xaa, 0xe6, 0x0b,
                                            0x63, 0x28, 0xe7, 0xc1, 0x50, 0x80, 0xcc, 0xe7, 0x86, 0xe5, 0xec, 0x31, 0x1d, 0x6b, 0x7b,
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                                            0x21, 0x74};

uint8_t RSA4096_mod[512]               = {  0xd1, 0xea, 0x52, 0xbb, 0xdb, 0xd6, 0xe7, 0x09, 0x79, 0x51, 0x26, 0xe7, 0x49, 0xa9, 0xef,
                                            0xa3, 0x47, 0x9f, 0x92, 0xd6, 0xf1, 0xb4, 0x45, 0x5e, 0x39, 0xe4, 0xb6, 0x8a, 0xcd, 0xf9,
                                            0xff, 0x43, 0xf2, 0x2e, 0xc1, 0xc4, 0x02, 0xd5, 0x1f, 0x7c, 0x03, 0x03, 0xaa, 0xe6, 0x0b,
                                            0x63, 0x28, 0xe7, 0xc1, 0x50, 0x80, 0xcc, 0xe7, 0x86, 0xe5, 0xec, 0x31, 0x1d, 0x6b, 0x7b,
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                                            0x7f, 0xf1};

uint8_t check_data_out4096[512]      = {   0x00, 0x02, 0x04, 0x7e, 0x89, 0xff, 0xd1, 0xf9, 0xdc, 0x23, 0xfd, 0x24, 0x52,
                                            0x70, 0xce, 0x4a, 0x69, 0x96, 0xd5, 0x70, 0x25, 0x2d, 0xb2, 0x69, 0xdf, 0x4e,
                                            0xef, 0x86, 0x7b, 0x86, 0xab, 0x39, 0x0c, 0x5c, 0xd0, 0xad, 0x03, 0xe7, 0xb9,
                                            0xf8, 0x9e, 0xb5, 0x5d, 0x05, 0xa7, 0xbf, 0x2c, 0xf3, 0x32, 0x2d, 0x3e, 0xeb,
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                                            0x77, 0x6f, 0x72, 0x6c, 0x64};

const uint32_t RSA4096_exp_length       = 512;
const uint32_t RSA4096_mod_length       = 512;

/* Output buffers */
uint32_t IV_Buffer[4] ;
uint32_t TAG_Buffer[4];
uint32_t phi_encrypted_4096[128]          = {0};
uint32_t exponent_encrypted_4096[128]     = {0};
uint8_t RSA_result_4096[512]              = {0};

/* USER CODE END PV */

/* Private function prototypes -----------------------------------------------*/
void SystemClock_Config(void);
static void MX_CCB_Init(void);
static void MX_ICACHE_Init(void);
/* USER CODE BEGIN PFP */

/* USER CODE END PFP */

/* Private user code ---------------------------------------------------------*/
/* USER CODE BEGIN 0 */

/* USER CODE END 0 */

/**
  * @brief  The application entry point.
  * @retval int
  */
int main(void)
{

  /* USER CODE BEGIN 1 */
  /* STM32H5xx HAL library initialization:
       - Systick timer is configured by default as source of time base, but user
             can eventually implement his proper time base source (a general purpose
             timer for example or other time source), keeping in mind that Time base
             duration should be kept 1ms since PPP_TIMEOUT_VALUEs are defined and
             handled in milliseconds basis.
       - Set NVIC Group Priority to 4
       - Low Level Initialization
     */
  /* USER CODE END 1 */

  /* MCU Configuration--------------------------------------------------------*/

  /* Reset of all peripherals, Initializes the Flash interface and the Systick. */
  HAL_Init();

  /* USER CODE BEGIN Init */

  /* USER CODE END Init */

  /* Configure the system clock */
  SystemClock_Config();

  /* USER CODE BEGIN SysInit */

  /* USER CODE END SysInit */

  /* Initialize all configured peripherals */
  MX_CCB_Init();
  MX_ICACHE_Init();
  /* USER CODE BEGIN 2 */
  /* -1- Initialize LEDs mounted on STM32H5F5J-DK board */
  BSP_LED_Init(LED_GREEN);
  BSP_LED_Init(LED_RED);

 /* Configure Wrapped Key */
  wrappedKeyConf.WrappingKeyType         = HAL_CCB_USER_KEY_HW;

  /* Fill RSA Modular exponentiation In parameters */
  RSAKey.pExp                            = RSA4096_exp_P;
  RSAKey.pPhi                            = RSA4096_phi_P;

  /* Fill RSA Modular exponentiation In parameters */
  RSAparam.expSizeByte                   = RSA4096_exp_length;
  RSAparam.modulusSizeByte               = RSA4096_mod_length;
  RSAparam.pMod                          = RSA4096_mod;

  /* Prepare RSA Modular exponentiation parameters  */
  RSAKeyBlob.pIV                         = IV_Buffer;
  RSAKeyBlob.pTag                        = TAG_Buffer;
  RSAKeyBlob.pWrappedExp                 = exponent_encrypted_4096;
  RSAKeyBlob.pWrappedPhi                 = phi_encrypted_4096;

  if ((HAL_CCB_RSA_WrapPrivateKey(&hccb, &RSAparam, &RSAKey, &wrappedKeyConf, &RSAKeyBlob) != HAL_OK) || (hccb.State != HAL_CCB_STATE_READY))
  {
    Error_Handler();
  }

  /* decrypt the encrypted "hello world" + PKCS1.5 padding which is RSA4096_expBas(already encrypted by public key on openssl and before CCB usage) */
  if ( HAL_CCB_RSA_ComputeModularExp(&hccb, &RSAparam, &wrappedKeyConf, &RSAKeyBlob , RSA4096_expBase, RSA_result_4096) != HAL_OK)
  {
    Error_Handler();
  }

  if (HAL_CCB_DeInit(&hccb) != HAL_OK)
  {
    Error_Handler();
  }

  /* check_data_out4096 is thye plain "hello world" + PKCS1.5 padding */
  if(memcmp(RSA_result_4096, check_data_out4096, 512) != 0)
  {
    while (1)
    {
      /* Toggle green led for error */
      (void) BSP_LED_Toggle(LED_GREEN);
      HAL_Delay(500);
    }
  }

  if (HAL_CCB_DeInit(&hccb) != HAL_OK)
  {
    Error_Handler();
  }

  /* USER CODE END 2 */

  /* Infinite loop */
  /* USER CODE BEGIN WHILE */
  while (1)
  {
    BSP_LED_On(LED_GREEN);
    /* USER CODE END WHILE */

    /* USER CODE BEGIN 3 */

  }
  /* USER CODE END 3 */
}

/**
  * @brief System Clock Configuration
  * @retval None
  */
void SystemClock_Config(void)
{
  RCC_OscInitTypeDef RCC_OscInitStruct = {0};
  RCC_ClkInitTypeDef RCC_ClkInitStruct = {0};
  RCC_CRSInitTypeDef RCC_CRSInitStruct = {0};

  /** Configure the main internal regulator output voltage
  */
  __HAL_PWR_VOLTAGESCALING_CONFIG(PWR_REGULATOR_VOLTAGE_SCALE0);

  while(!__HAL_PWR_GET_FLAG(PWR_FLAG_VOSRDY)) {}

  /** Initializes the RCC Oscillators according to the specified parameters
  * in the RCC_OscInitTypeDef structure.
  */
  RCC_OscInitStruct.OscillatorType = RCC_OSCILLATORTYPE_HSI48|RCC_OSCILLATORTYPE_HSE;
  RCC_OscInitStruct.HSEState = RCC_HSE_ON;
  RCC_OscInitStruct.HSI48State = RCC_HSI48_ON;
  RCC_OscInitStruct.PLL.PLLState = RCC_PLL_ON;
  RCC_OscInitStruct.PLL.PLLSource = RCC_PLL1_SOURCE_HSE;
  RCC_OscInitStruct.PLL.PLLM = 24;
  RCC_OscInitStruct.PLL.PLLN = 250;
  RCC_OscInitStruct.PLL.PLLP = 2;
  RCC_OscInitStruct.PLL.PLLQ = 2;
  RCC_OscInitStruct.PLL.PLLR = 2;
  RCC_OscInitStruct.PLL.PLLRGE = RCC_PLL1_VCIRANGE_1;
  RCC_OscInitStruct.PLL.PLLVCOSEL = RCC_PLL1_VCORANGE_WIDE;
  RCC_OscInitStruct.PLL.PLLFRACN = 0;
  if (HAL_RCC_OscConfig(&RCC_OscInitStruct) != HAL_OK)
  {
    Error_Handler();
  }

  /** Initializes the CPU, AHB and APB buses clocks
  */
  RCC_ClkInitStruct.ClockType = RCC_CLOCKTYPE_HCLK|RCC_CLOCKTYPE_SYSCLK
                              |RCC_CLOCKTYPE_PCLK1|RCC_CLOCKTYPE_PCLK2
                              |RCC_CLOCKTYPE_PCLK3;
  RCC_ClkInitStruct.SYSCLKSource = RCC_SYSCLKSOURCE_PLLCLK;
  RCC_ClkInitStruct.AHBCLKDivider = RCC_SYSCLK_DIV1;
  RCC_ClkInitStruct.APB1CLKDivider = RCC_HCLK_DIV1;
  RCC_ClkInitStruct.APB2CLKDivider = RCC_HCLK_DIV1;
  RCC_ClkInitStruct.APB3CLKDivider = RCC_HCLK_DIV1;

  if (HAL_RCC_ClockConfig(&RCC_ClkInitStruct, FLASH_LATENCY_5) != HAL_OK)
  {
    Error_Handler();
  }

  /** Enable the CRS APB clock
  */
  __HAL_RCC_CRS_CLK_ENABLE();

  /** Configures CRS
  */
  RCC_CRSInitStruct.Prescaler = RCC_CRS_SYNC_DIV1;
  RCC_CRSInitStruct.Source = RCC_CRS_SYNC_SOURCE_GPIO;
  RCC_CRSInitStruct.Polarity = RCC_CRS_SYNC_POLARITY_RISING;
  RCC_CRSInitStruct.ReloadValue = __HAL_RCC_CRS_RELOADVALUE_CALCULATE(48000000,1);
  RCC_CRSInitStruct.ErrorLimitValue = 34;
  RCC_CRSInitStruct.HSI48CalibrationValue = 32;

  HAL_RCCEx_CRSConfig(&RCC_CRSInitStruct);

  /** Configure the programming delay
  */
  __HAL_FLASH_SET_PROGRAM_DELAY(FLASH_PROGRAMMING_DELAY_2);
}

/**
  * @brief CCB Initialization Function
  * @param None
  * @retval None
  */
static void MX_CCB_Init(void)
{

  /* USER CODE BEGIN CCB_Init 0 */

  /* USER CODE END CCB_Init 0 */

  /* USER CODE BEGIN CCB_Init 1 */

  /* USER CODE END CCB_Init 1 */
  hccb.Instance = CCB;
  if (HAL_CCB_Init(&hccb) != HAL_OK)
  {
    Error_Handler();
  }
  /* USER CODE BEGIN CCB_Init 2 */

  /* USER CODE END CCB_Init 2 */

}

/**
  * @brief ICACHE Initialization Function
  * @param None
  * @retval None
  */
static void MX_ICACHE_Init(void)
{

  /* USER CODE BEGIN ICACHE_Init 0 */

  /* USER CODE END ICACHE_Init 0 */

  /* USER CODE BEGIN ICACHE_Init 1 */

  /* USER CODE END ICACHE_Init 1 */

  /** Enable instruction cache (default 2-ways set associative cache)
  */
  if (HAL_ICACHE_Enable() != HAL_OK)
  {
    Error_Handler();
  }
  /* USER CODE BEGIN ICACHE_Init 2 */

  /* USER CODE END ICACHE_Init 2 */

}

/* USER CODE BEGIN 4 */

/* USER CODE END 4 */

/**
  * @brief  This function is executed in case of error occurrence.
  * @retval None
  */
void Error_Handler(void)
{
  /* USER CODE BEGIN Error_Handler_Debug */
  /* User can add his own implementation to report the HAL error return state */
  while(1)
  {
    BSP_LED_On(LED_RED);
  }
  /* USER CODE END Error_Handler_Debug */
}
#ifdef USE_FULL_ASSERT
/**
  * @brief  Reports the name of the source file and the source line number
  *         where the assert_param error has occurred.
  * @param  file: pointer to the source file name
  * @param  line: assert_param error line source number
  * @retval None
  */
void assert_failed(uint8_t *file, uint32_t line)
{
  /* USER CODE BEGIN 6 */
  /* User can add his own implementation to report the file name and line number,
    ex: printf("Wrong parameters value: file %s on line %d\r\n", file, line) */
  /* Infinite loop */
  while (1)
  {
  }

  /* USER CODE END 6 */
}
#endif /* USE_FULL_ASSERT */
